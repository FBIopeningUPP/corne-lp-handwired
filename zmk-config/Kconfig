## zmk-config/Kconfig
```kconfig
config CORNE_LP_SCREEN
    bool "Corne LP animated OLED screen (Blip)"
    default y
    depends on ZMK_DISPLAY && ZMK_DISPLAY_STATUS_SCREEN_CUSTOM
    select LV_USE_CANVAS
    select LV_USE_IMG

if CORNE_LP_SCREEN

config CORNE_LP_OLED_FLIP
    bool "Turn the OLED image upside down (set this if Blip is upside down)"
    default n

config CORNE_LP_FPS
    int "Animation frames per second"
    default 10
    range 2 20

endif
```

## zmk-config/boards/shields/corne_lp/Kconfig.defconfig
```kconfig
if SHIELD_CORNE_LP_LEFT

config ZMK_KEYBOARD_NAME
    default "Corne LP"

config ZMK_SPLIT_ROLE_CENTRAL
    default y

endif

if SHIELD_CORNE_LP_LEFT || SHIELD_CORNE_LP_RIGHT

config ZMK_SPLIT
    default y

config ZMK_DISPLAY
    default y

choice ZMK_DISPLAY_STATUS_SCREEN
    default ZMK_DISPLAY_STATUS_SCREEN_CUSTOM
endchoice

config ZMK_POINTING
    default y

if ZMK_DISPLAY

config I2C
    default y

config SSD1306
    default y

endif # ZMK_DISPLAY

if LVGL

config LV_Z_VDB_SIZE
    default 100

config LV_DPI_DEF
    default 148

config LV_Z_BITS_PER_PIXEL
    default 1

choice LV_COLOR_DEPTH
    default LV_COLOR_DEPTH_1
endchoice

endif # LVGL

endif
```

## zmk-config/boards/shields/corne_lp/Kconfig.shield
```kconfig
config SHIELD_CORNE_LP_LEFT
    def_bool $(shields_list_contains,corne_lp_left)

config SHIELD_CORNE_LP_RIGHT
    def_bool $(shields_list_contains,corne_lp_right)
```

## zmk-config/config/west.yml
```yaml
manifest:
  remotes:
    - name: zmkfirmware
      url-base: https://github.com/zmkfirmware
    - name: petejohanson
      url-base: https://github.com/petejohanson
  projects:
    - name: zmk
      remote: zmkfirmware
      revision: v0.3
      import: app/west.yml
    - name: cirque-input-module
      remote: petejohanson
      revision: 0de55f36bc720b5be3d8880dc856d4d78baf5214
  self:
    path: config
```
